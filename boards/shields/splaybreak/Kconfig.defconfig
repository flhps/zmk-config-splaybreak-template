## boards/shields/splaybreak/Kconfig.defconfig
```kconfig
if SHIELD_SPLAYBREAK_LEFT

config ZMK_KEYBOARD_NAME
    default "SplayBreak"

config ZMK_SPLIT_ROLE_CENTRAL
    default y

endif

if SHIELD_SPLAYBREAK_LEFT || SHIELD_SPLAYBREAK_RIGHT

config ZMK_SPLIT
    default y

endif
```

## boards/shields/splaybreak/Kconfig.shield
```kconfig
config SHIELD_SPLAYBREAK_LEFT
    def_bool $(shields_list_contains,splaybreak_left)

config SHIELD_SPLAYBREAK_RIGHT
    def_bool $(shields_list_contains,splaybreak_right)
```
